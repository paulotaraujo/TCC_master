// =============================================================================
// v_2.ino - ESP32 embedded receiver/protection prototype
//
// Based on receiver/python/v_1/v_1.ino + read_from_generator_rms_robust.py.
// The ESP32 now owns the critical path:
//   ADC -> offset/scale -> cycle detection -> Fourier phasors -> protections -> relay.
//
// Logging is intentionally decoupled from protection. The firmware keeps a compact
// circular RAM log and dumps essential CSV only when requested over Serial.
// This is the first embedded step before replacing RAM logging with SD/binary log.
// =============================================================================

#include <Arduino.h>
#include <math.h>

static const int ADC_PIN_V = 34;
static const int ADC_PIN_I = 35;
static const int RELAY_PIN = 25;

static const uint32_t SERIAL_BAUD = 921600;
static const uint32_t SAMPLE_RATE_HZ = 2000;
static const uint32_t SAMPLE_PERIOD_US = 1000000UL / SAMPLE_RATE_HZ;
static const int N_AVG = 8;

static const float ADC_MAX = 4095.0f;
static const float ADC_VREF = 3.3f;

// Keep these values synchronized with receiver_config.json generated by v_6.
static const float V_SCALE_ENG_PER_VOLT = 1168993.5483870967f;
static const float I_SCALE_ENG_PER_VOLT = 11851.612903225807f;
static const float V_NOMINAL_RMS = 256247.015625f;
static const float I_NOMINAL_RMS = 1298.9552f;
static const float FREQ_REF_HZ = 60.0f;
static const float F_MIN_HZ = 55.0f;
static const float F_MAX_HZ = 65.0f;

static const float OFFSET_TAU_S = 1.0f;
static const float ZC_HYST_REAL = 0.03f;
static const bool NORMALIZE_TO_COMTRADE = false;
static const int PREFAULT_CYCLES = 10;
static const float NORM_MIN_PU = 0.5f;

// Protection configuration. Enable only the functions needed for the test.
static const bool OC_ENABLED = false;
static const float OC_51_PCT = 10.0f;
static const float OC_50_PCT = 20.0f;
static const float OC_51_DELAY_S = 0.5f;

static const bool DIST_ENABLED = false;
static const float DIST_LINE_Z_OHM = 52.12496f;
static const float DIST_Z1_PCT = 80.0f;
static const float DIST_Z2_PCT = 120.0f;
static const float DIST_Z2_DELAY_S = 0.05f;
static const float DIST_LINE_ANGLE_DEG = 86.636f;
static const float DIST_MIN_CURRENT = 0.05f * I_NOMINAL_RMS;

static const bool DIR67_ENABLED = false;
static const bool DIR67_FORWARD = true;
static const float DIR67_ANGLE_DEG = 86.636f;
static const float DIR67_WINDOW_DEG = 90.0f;
static const float DIR67_POWER_MIN_W = 10000.0f;

static const bool UV_ENABLED = false;
static const float UV_PICKUP_PCT = 90.0f;
static const float UV_DELAY_S = 0.2f;

static const bool OV_ENABLED = false;
static const float OV_PICKUP_PCT = 110.0f;
static const float OV_DELAY_S = 0.2f;

static const bool RELAY_ACTIVE_HIGH = true;
static const bool STREAM_CYCLE_CSV = false;

static const uint8_t FLAG_ADC_SAT = 1 << 3;
static const uint8_t FLAG_OUTLIER = 1 << 4;
static const uint8_t FLAG_INCOMPLETE_CYCLE = 1 << 5;
static const uint8_t FLAG_FREQ_OOR = 1 << 6;

static const uint16_t MAX_CYCLE_SAMPLES = 160;
static const uint16_t LOG_CAPACITY = 512;

struct Phasor {
  float mag = 0.0f;
  float angleDeg = 0.0f;
};

struct MhoCircle {
  float centerR = 0.0f;
  float centerX = 0.0f;
  float radius = 0.0f;
};

struct LogRow {
  float dev_t_s;
  uint32_t dev_t_us;
  uint32_t seq;
  uint16_t adc_v;
  uint16_t adc_i;
  float v_inst;
  float i_inst;
  float v1_mag;
  float i1_mag;
  float v1_angle_deg;
  float i1_angle_deg;
  float vi_angle_deg;
  uint8_t fourier_valid;
  float f_est_hz;
  uint8_t norm_ready;
  float norm_gain_v;
  float norm_gain_i;
  float oc_51_timer_s;
  uint8_t oc_51_active;
  uint8_t oc_50_trip;
  uint8_t oc_51_trip;
  uint8_t oc_trip;
  float dist_z_mag_ohm;
  float dist_z_angle_deg;
  float dist_r_ohm;
  float dist_x_ohm;
  float dist_fault_pct;
  float dist_z2_timer_s;
  uint8_t dist_z1_trip;
  uint8_t dist_z2_trip;
  uint8_t dist_trip;
  float dir67_power_w;
  float dir67_prefault_power_w;
  uint8_t dir67_permit;
  uint8_t dir67_block_active;
  float uv_timer_s;
  float ov_timer_s;
  uint8_t uv_trip;
  uint8_t ov_trip;
  uint32_t cycle_id;
  uint8_t cycle_update;
  uint8_t quality_flags;
};

static LogRow g_log[LOG_CAPACITY];
static uint16_t g_logHead = 0;
static uint16_t g_logCount = 0;

static uint32_t g_seq = 0;
static bool g_running = true;
static bool g_streamCycleCsv = STREAM_CYCLE_CSV;
static bool g_csvHeaderPrinted = false;

static float g_vOffset = 1.65f;
static float g_iOffset = 1.65f;
static float g_vPrev = 0.0f;
static float g_iPrev = 0.0f;
static bool g_havePrev = false;

static int8_t g_zcState = 0;
static uint32_t g_cycleStartUs = 0;
static bool g_haveCycleStart = false;
static uint16_t g_cycleN = 0;
static float g_cycleSumV2 = 0.0f;
static float g_cycleSumI2 = 0.0f;
static float g_cycleV[MAX_CYCLE_SAMPLES];
static float g_cycleI[MAX_CYCLE_SAMPLES];
static uint8_t g_cycleFlags = 0;

static uint32_t g_cycleId = 0;
static float g_v1Mag = 0.0f;
static float g_i1Mag = 0.0f;
static float g_v1Angle = 0.0f;
static float g_i1Angle = 0.0f;
static float g_viAngle = 0.0f;
static float g_fEst = 0.0f;
static uint8_t g_fourierValid = 0;
static uint8_t g_lastQualityFlags = 0;

static uint8_t g_normReady = 0;
static float g_normGainV = 1.0f;
static float g_normGainI = 1.0f;
static float g_prefaultV[PREFAULT_CYCLES];
static float g_prefaultI[PREFAULT_CYCLES];
static uint8_t g_prefaultCount = 0;

static float g_oc51Pickup = I_NOMINAL_RMS * (1.0f + OC_51_PCT / 100.0f);
static float g_oc50Pickup = I_NOMINAL_RMS * (1.0f + OC_50_PCT / 100.0f);
static float g_oc51Dropout = 0.95f * g_oc51Pickup;
static float g_oc51Timer = 0.0f;
static uint8_t g_oc51Active = 0;
static uint8_t g_oc50Trip = 0;
static uint8_t g_oc51Trip = 0;
static uint8_t g_ocTrip = 0;

static float g_distZ1Ohm = DIST_LINE_Z_OHM * (DIST_Z1_PCT / 100.0f);
static float g_distZ2Ohm = DIST_LINE_Z_OHM * (DIST_Z2_PCT / 100.0f);
static float g_distZ2DropoutOhm = 1.05f * g_distZ2Ohm;
static MhoCircle g_distZ1Circle;
static MhoCircle g_distZ2Circle;
static float g_distZMag = 0.0f;
static float g_distZAngle = 0.0f;
static float g_distR = 0.0f;
static float g_distX = 0.0f;
static float g_distFaultPct = 0.0f;
static float g_distZ2Timer = 0.0f;
static uint8_t g_distZ1Trip = 0;
static uint8_t g_distZ2Trip = 0;
static uint8_t g_distTrip = 0;
static uint8_t g_dir67Permit = 0;
static uint8_t g_dir67BlockActive = 0;
static float g_dir67Power = 0.0f;
static float g_dir67PrefaultPower = 0.0f;

static float g_uvPickup = V_NOMINAL_RMS * (UV_PICKUP_PCT / 100.0f);
static float g_uvDropout = 1.03f * g_uvPickup;
static float g_ovPickup = V_NOMINAL_RMS * (OV_PICKUP_PCT / 100.0f);
static float g_ovDropout = 0.97f * g_ovPickup;
static float g_uvTimer = 0.0f;
static float g_ovTimer = 0.0f;
static uint8_t g_uvTrip = 0;
static uint8_t g_ovTrip = 0;

static float wrapAngleDeg(float angleDeg) {
  float wrapped = fmodf(angleDeg + 180.0f, 360.0f);
  if (wrapped < 0.0f) wrapped += 360.0f;
  wrapped -= 180.0f;
  if (wrapped == -180.0f) return 180.0f;
  return wrapped;
}

static float adcToVolts(uint16_t adc) {
  return ((float)adc / ADC_MAX) * ADC_VREF;
}

static float autoOutlierStep(float ampPeak, float freqHz, float sampleRateHz) {
  float fs = max(1.0f, sampleRateHz);
  float f = max(1.0f, freqHz);
  float a = max(1.0f, fabsf(ampPeak));
  float maxStep = a * (2.0f * PI * f) / fs;
  return max(0.8f, 6.0f * maxStep);
}

static uint16_t readAdcAvg(int pin, int n) {
  uint32_t acc = 0;
  for (int i = 0; i < n; ++i) acc += analogRead(pin);
  uint32_t avg = acc / (uint32_t)n;
  if (avg > 4095) avg = 4095;
  return (uint16_t)avg;
}

static Phasor fundamentalPhasorRms(const float *samples, uint16_t n) {
  Phasor out;
  if (n < 2) return out;

  float re = 0.0f;
  float im = 0.0f;
  for (uint16_t k = 0; k < n; ++k) {
    float theta = (2.0f * PI * (float)k) / (float)n;
    re += samples[k] * cosf(theta);
    im -= samples[k] * sinf(theta);
  }

  float peakMag = (2.0f / (float)n) * sqrtf(re * re + im * im);
  out.mag = peakMag / sqrtf(2.0f);
  out.angleDeg = wrapAngleDeg(atan2f(im, re) * 180.0f / PI);
  return out;
}

static MhoCircle mhoCircle(float reachOhm, float lineAngleDeg) {
  float angleRad = lineAngleDeg * PI / 180.0f;
  MhoCircle circle;
  circle.radius = 0.5f * reachOhm;
  circle.centerR = circle.radius * cosf(angleRad);
  circle.centerX = circle.radius * sinf(angleRad);
  return circle;
}

static bool mhoOperates(float rOhm, float xOhm, float reachOhm, float lineAngleDeg) {
  MhoCircle c = mhoCircle(reachOhm, lineAngleDeg);
  float dr = rOhm - c.centerR;
  float dx = xOhm - c.centerX;
  return (dr * dr + dx * dx) <= (c.radius * c.radius);
}

static void setRelay(bool trip) {
  digitalWrite(RELAY_PIN, trip == RELAY_ACTIVE_HIGH ? HIGH : LOW);
}

static void printCsvHeader() {
  Serial.println(
    "dev_t_s,dev_t_us,seq,adc_34,adc_35,v_inst,i_inst,"
    "v1_mag,i1_mag,v1_angle_deg,i1_angle_deg,vi_angle_deg,fourier_valid,f_est_hz,"
    "norm_ready,norm_gain_v,norm_gain_i,"
    "oc_51_pickup,oc_50_pickup,oc_51_timer_s,oc_51_active,oc_50_trip,oc_51_trip,oc_trip,"
    "dist_line_z_ohm,dist_z1_ohm,dist_z2_ohm,dist_line_angle_deg,"
    "dist_z_mag_ohm,dist_z_angle_deg,dist_r_ohm,dist_x_ohm,dist_fault_pct,dist_z2_timer_s,"
    "dist_z1_trip,dist_z2_trip,dist_trip,"
    "dir67_direction,dir67_angle_deg,dir67_window_deg,dir67_power_w,dir67_prefault_power_w,"
    "dir67_power_min_w,dir67_permit,dir67_block_active,"
    "uv_pickup,ov_pickup,uv_timer_s,ov_timer_s,uv_trip,ov_trip,voltage_trip_code,"
    "cycle_id,cycle_update,quality_flags"
  );
  g_csvHeaderPrinted = true;
}

static const char *voltageTripCode() {
  if (g_uvTrip) return "27";
  if (g_ovTrip) return "59";
  return "NONE";
}

static const char *distTripCode() {
  if (g_distZ1Trip) return "21Z1";
  if (g_distZ2Trip) return "21Z2";
  return "NONE";
}

static const char *ocTripCode() {
  if (g_oc50Trip) return "50";
  if (g_oc51Trip) return "51";
  return "NONE";
}

static void printCsvRow(const LogRow &row) {
  Serial.printf(
    "%.9f,%lu,%lu,%u,%u,%.9f,%.9f,"
    "%.9f,%.9f,%.6f,%.6f,%.6f,%u,%.6f,"
    "%u,%.9f,%.9f,"
    "%.9f,%.9f,%.9f,%u,%u,%u,%u,"
    "%.9f,%.9f,%.9f,%.6f,"
    "%.9f,%.6f,%.9f,%.9f,%.9f,%.9f,"
    "%u,%u,%u,"
    "%s,%.6f,%.6f,%.9f,%.9f,%.9f,%u,%u,"
    "%.9f,%.9f,%.9f,%.9f,%u,%u,%s,"
    "%lu,%u,%u\n",
    row.dev_t_s,
    (unsigned long)row.dev_t_us,
    (unsigned long)row.seq,
    row.adc_v,
    row.adc_i,
    row.v_inst,
    row.i_inst,
    row.v1_mag,
    row.i1_mag,
    row.v1_angle_deg,
    row.i1_angle_deg,
    row.vi_angle_deg,
    row.fourier_valid,
    row.f_est_hz,
    row.norm_ready,
    row.norm_gain_v,
    row.norm_gain_i,
    g_oc51Pickup,
    g_oc50Pickup,
    row.oc_51_timer_s,
    row.oc_51_active,
    row.oc_50_trip,
    row.oc_51_trip,
    row.oc_trip,
    DIST_LINE_Z_OHM,
    g_distZ1Ohm,
    g_distZ2Ohm,
    DIST_LINE_ANGLE_DEG,
    row.dist_z_mag_ohm,
    row.dist_z_angle_deg,
    row.dist_r_ohm,
    row.dist_x_ohm,
    row.dist_fault_pct,
    row.dist_z2_timer_s,
    row.dist_z1_trip,
    row.dist_z2_trip,
    row.dist_trip,
    DIR67_FORWARD ? "forward" : "reverse",
    DIR67_ANGLE_DEG,
    DIR67_WINDOW_DEG,
    row.dir67_power_w,
    row.dir67_prefault_power_w,
    DIR67_POWER_MIN_W,
    row.dir67_permit,
    row.dir67_block_active,
    g_uvPickup,
    g_ovPickup,
    row.uv_timer_s,
    row.ov_timer_s,
    row.uv_trip,
    row.ov_trip,
    voltageTripCode(),
    (unsigned long)row.cycle_id,
    row.cycle_update,
    row.quality_flags
  );
}

static void pushLog(const LogRow &row) {
  g_log[g_logHead] = row;
  g_logHead = (uint16_t)((g_logHead + 1) % LOG_CAPACITY);
  if (g_logCount < LOG_CAPACITY) g_logCount++;
}

static void dumpLogCsv() {
  printCsvHeader();
  uint16_t start = (g_logHead + LOG_CAPACITY - g_logCount) % LOG_CAPACITY;
  for (uint16_t i = 0; i < g_logCount; ++i) {
    uint16_t idx = (uint16_t)((start + i) % LOG_CAPACITY);
    printCsvRow(g_log[idx]);
    if ((i % 32) == 0) delay(1);
  }
  Serial.printf("DUMP_DONE rows=%u\n", g_logCount);
}

static void clearLog() {
  g_logHead = 0;
  g_logCount = 0;
}

static float medianSmall(float *values, uint8_t count) {
  for (uint8_t i = 1; i < count; ++i) {
    float key = values[i];
    int j = i - 1;
    while (j >= 0 && values[j] > key) {
      values[j + 1] = values[j];
      j--;
    }
    values[j + 1] = key;
  }
  return values[count / 2];
}

static void resetTrips() {
  g_oc51Timer = 0.0f;
  g_oc51Active = 0;
  g_oc50Trip = 0;
  g_oc51Trip = 0;
  g_ocTrip = 0;
  g_distZ2Timer = 0.0f;
  g_distZ1Trip = 0;
  g_distZ2Trip = 0;
  g_distTrip = 0;
  g_dir67Permit = 0;
  g_dir67BlockActive = 0;
  g_uvTimer = 0.0f;
  g_ovTimer = 0.0f;
  g_uvTrip = 0;
  g_ovTrip = 0;
  setRelay(false);
}

static void evaluateProtections(float cycleDtS) {
  bool evalReady = g_fourierValid == 1 && (!NORMALIZE_TO_COMTRADE || g_normReady == 1);

  if (OC_ENABLED && evalReady) {
    if (g_i1Mag >= g_oc50Pickup) {
      g_oc50Trip = 1;
      g_ocTrip = 1;
    }
    if (g_i1Mag >= g_oc51Pickup) {
      g_oc51Active = 1;
      g_oc51Timer += cycleDtS;
      if (g_oc51Timer >= OC_51_DELAY_S) {
        g_oc51Trip = 1;
        g_ocTrip = 1;
      }
    } else if (g_i1Mag < g_oc51Dropout) {
      if (!g_oc51Trip) {
        g_oc51Active = 0;
        g_oc51Timer = 0.0f;
      }
    } else {
      g_oc51Active = 0;
    }
  }

  if (DIST_ENABLED && evalReady && g_i1Mag > max(1e-12f, DIST_MIN_CURRENT)) {
    g_distZMag = g_v1Mag / max(1e-12f, g_i1Mag);
    g_distZAngle = wrapAngleDeg(g_v1Angle - g_i1Angle);
    float angleRad = g_distZAngle * PI / 180.0f;
    g_distR = g_distZMag * cosf(angleRad);
    g_distX = g_distZMag * sinf(angleRad);
    g_distFaultPct = (g_distZMag / DIST_LINE_Z_OHM) * 100.0f;

    bool z1Mho = mhoOperates(g_distR, g_distX, g_distZ1Ohm, DIST_LINE_ANGLE_DEG) && g_distZMag <= g_distZ1Ohm;
    bool z2Mho = mhoOperates(g_distR, g_distX, g_distZ2Ohm, DIST_LINE_ANGLE_DEG) && !z1Mho && g_distZMag <= g_distZ2Ohm;
    bool z2Dropout = mhoOperates(g_distR, g_distX, g_distZ2DropoutOhm, DIST_LINE_ANGLE_DEG);
    bool anyMho = z1Mho || z2Mho;

    bool dirOk = true;
    if (DIR67_ENABLED) {
      g_dir67Power = g_v1Mag * g_i1Mag * cosf((g_v1Angle - g_i1Angle) * PI / 180.0f);
      if (!anyMho && fabsf(g_dir67Power) > DIR67_POWER_MIN_W) {
        g_dir67PrefaultPower = g_dir67Power;
      }
      bool forward = g_dir67PrefaultPower > DIR67_POWER_MIN_W;
      bool reverse = g_dir67PrefaultPower < -DIR67_POWER_MIN_W;
      dirOk = DIR67_FORWARD ? forward : reverse;
    } else {
      g_dir67Power = 0.0f;
      dirOk = true;
    }
    g_dir67Permit = (anyMho && dirOk) ? 1 : 0;

    if (anyMho && !g_dir67Permit) {
      g_dir67BlockActive = 1;
      g_distZ2Timer = 0.0f;
    } else if (z1Mho) {
      g_dir67BlockActive = 0;
      g_distZ1Trip = 1;
      g_distTrip = 1;
    } else if (z2Mho) {
      g_dir67BlockActive = 0;
      g_distZ2Timer += cycleDtS;
      if (g_distZ2Timer >= DIST_Z2_DELAY_S) {
        g_distZ2Trip = 1;
        g_distTrip = 1;
      }
    } else if (!z2Dropout && !g_distZ2Trip) {
      g_distZ2Timer = 0.0f;
      g_dir67BlockActive = 0;
    } else {
      g_dir67BlockActive = 0;
    }
  }

  if ((UV_ENABLED || OV_ENABLED) && evalReady) {
    if (UV_ENABLED) {
      if (g_v1Mag <= g_uvPickup) {
        g_uvTimer += cycleDtS;
        if (g_uvTimer >= UV_DELAY_S) g_uvTrip = 1;
      } else if (g_v1Mag > g_uvDropout && !g_uvTrip) {
        g_uvTimer = 0.0f;
      }
    }
    if (OV_ENABLED) {
      if (g_v1Mag >= g_ovPickup) {
        g_ovTimer += cycleDtS;
        if (g_ovTimer >= OV_DELAY_S) g_ovTrip = 1;
      } else if (g_v1Mag < g_ovDropout && !g_ovTrip) {
        g_ovTimer = 0.0f;
      }
    }
  }

  bool trip = g_ocTrip || g_distTrip || g_uvTrip || g_ovTrip;
  setRelay(trip);
}

static void closeCycle(uint32_t nowUs) {
  if (!g_haveCycleStart) return;

  uint32_t periodUs = nowUs - g_cycleStartUs;
  uint8_t localFlags = g_cycleFlags;
  uint8_t localValid = 1;

  if (g_cycleN < 8) {
    localFlags |= FLAG_INCOMPLETE_CYCLE;
    localValid = 0;
    g_v1Mag = 0.0f;
    g_i1Mag = 0.0f;
    g_v1Angle = 0.0f;
    g_i1Angle = 0.0f;
    g_fEst = 0.0f;
  } else {
    Phasor v1 = fundamentalPhasorRms(g_cycleV, g_cycleN);
    Phasor i1 = fundamentalPhasorRms(g_cycleI, g_cycleN);
    g_v1Mag = v1.mag;
    g_i1Mag = i1.mag;
    g_v1Angle = v1.angleDeg;
    g_i1Angle = i1.angleDeg;
    g_fEst = 1000000.0f / max(1.0f, (float)periodUs);
    if (!(F_MIN_HZ <= g_fEst && g_fEst <= F_MAX_HZ)) {
      localFlags |= FLAG_FREQ_OOR;
      localValid = 0;
    }

    if (NORMALIZE_TO_COMTRADE && localValid == 1) {
      float minVRaw = max(1e-9f, NORM_MIN_PU * V_NOMINAL_RMS);
      float minIRaw = max(1e-9f, NORM_MIN_PU * I_NOMINAL_RMS);
      bool goodForNorm = g_v1Mag >= minVRaw && g_i1Mag >= minIRaw;
      if (!g_normReady && goodForNorm && g_prefaultCount < PREFAULT_CYCLES) {
        g_prefaultV[g_prefaultCount] = g_v1Mag;
        g_prefaultI[g_prefaultCount] = g_i1Mag;
        g_prefaultCount++;
        if (g_prefaultCount >= PREFAULT_CYCLES) {
          float tmpV[PREFAULT_CYCLES];
          float tmpI[PREFAULT_CYCLES];
          for (int i = 0; i < PREFAULT_CYCLES; ++i) {
            tmpV[i] = g_prefaultV[i];
            tmpI[i] = g_prefaultI[i];
          }
          g_normGainV = V_NOMINAL_RMS / max(1e-9f, medianSmall(tmpV, PREFAULT_CYCLES));
          g_normGainI = I_NOMINAL_RMS / max(1e-9f, medianSmall(tmpI, PREFAULT_CYCLES));
          g_normReady = 1;
        }
      }
      if (g_normReady) {
        g_v1Mag *= g_normGainV;
        g_i1Mag *= g_normGainI;
      }
    }
  }

  g_viAngle = wrapAngleDeg(g_i1Angle - g_v1Angle);
  g_fourierValid = localValid;
  g_lastQualityFlags = localFlags;
  evaluateProtections((float)periodUs / 1000000.0f);
  g_cycleId++;
}

static void resetCycle(uint32_t nowUs) {
  g_cycleStartUs = nowUs;
  g_haveCycleStart = true;
  g_cycleN = 0;
  g_cycleSumV2 = 0.0f;
  g_cycleSumI2 = 0.0f;
  g_cycleFlags = 0;
}

static void appendCycleSample(float vInst, float iInst) {
  if (!g_haveCycleStart) return;
  if (g_cycleN < MAX_CYCLE_SAMPLES) {
    g_cycleV[g_cycleN] = vInst;
    g_cycleI[g_cycleN] = iInst;
    g_cycleN++;
  } else {
    g_cycleFlags |= FLAG_INCOMPLETE_CYCLE;
  }
  g_cycleSumV2 += vInst * vInst;
  g_cycleSumI2 += iInst * iInst;
}

static void logSample(uint32_t nowUs, uint16_t adcV, uint16_t adcI, float vInst, float iInst, uint8_t cycleUpdate) {
  LogRow row;
  row.dev_t_s = (float)nowUs / 1000000.0f;
  row.dev_t_us = nowUs;
  row.seq = g_seq;
  row.adc_v = adcV;
  row.adc_i = adcI;
  row.v_inst = vInst;
  row.i_inst = iInst;
  row.v1_mag = g_v1Mag;
  row.i1_mag = g_i1Mag;
  row.v1_angle_deg = g_v1Angle;
  row.i1_angle_deg = g_i1Angle;
  row.vi_angle_deg = g_viAngle;
  row.fourier_valid = g_fourierValid;
  row.f_est_hz = g_fEst;
  row.norm_ready = g_normReady;
  row.norm_gain_v = g_normGainV;
  row.norm_gain_i = g_normGainI;
  row.oc_51_timer_s = g_oc51Timer;
  row.oc_51_active = g_oc51Active;
  row.oc_50_trip = g_oc50Trip;
  row.oc_51_trip = g_oc51Trip;
  row.oc_trip = g_ocTrip;
  row.dist_z_mag_ohm = g_distZMag;
  row.dist_z_angle_deg = g_distZAngle;
  row.dist_r_ohm = g_distR;
  row.dist_x_ohm = g_distX;
  row.dist_fault_pct = g_distFaultPct;
  row.dist_z2_timer_s = g_distZ2Timer;
  row.dist_z1_trip = g_distZ1Trip;
  row.dist_z2_trip = g_distZ2Trip;
  row.dist_trip = g_distTrip;
  row.dir67_power_w = g_dir67Power;
  row.dir67_prefault_power_w = g_dir67PrefaultPower;
  row.dir67_permit = g_dir67Permit;
  row.dir67_block_active = g_dir67BlockActive;
  row.uv_timer_s = g_uvTimer;
  row.ov_timer_s = g_ovTimer;
  row.uv_trip = g_uvTrip;
  row.ov_trip = g_ovTrip;
  row.cycle_id = g_cycleId;
  row.cycle_update = cycleUpdate;
  row.quality_flags = g_lastQualityFlags;

  pushLog(row);
  if (g_streamCycleCsv && cycleUpdate) {
    if (!g_csvHeaderPrinted) printCsvHeader();
    printCsvRow(row);
  }
}

static void processSample() {
  static uint32_t nextUs = 0;
  uint32_t now = micros();
  if (nextUs == 0) nextUs = now + SAMPLE_PERIOD_US;
  if ((int32_t)(now - nextUs) < 0) return;
  nextUs += SAMPLE_PERIOD_US;
  if ((int32_t)(now - nextUs) > (int32_t)(4 * SAMPLE_PERIOD_US)) {
    nextUs = now + SAMPLE_PERIOD_US;
  }
  if (!g_running) return;

  uint16_t adcV = readAdcAvg(ADC_PIN_V, N_AVG);
  uint16_t adcI = readAdcAvg(ADC_PIN_I, N_AVG);
  uint32_t sampleUs = micros();

  float dtS = (float)SAMPLE_PERIOD_US / 1000000.0f;
  float vAdc = adcToVolts(adcV);
  float iAdc = adcToVolts(adcI);

  if (adcV <= 1 || adcV >= 4094 || adcI <= 1 || adcI >= 4094) {
    g_cycleFlags |= FLAG_ADC_SAT;
  }

  float alpha = dtS / max(1e-6f, OFFSET_TAU_S);
  if (alpha > 1.0f) alpha = 1.0f;
  g_vOffset += alpha * (vAdc - g_vOffset);
  g_iOffset += alpha * (iAdc - g_iOffset);

  float vInst = (vAdc - g_vOffset) * V_SCALE_ENG_PER_VOLT;
  float iInst = (iAdc - g_iOffset) * I_SCALE_ENG_PER_VOLT;
  float vAcAdc = vAdc - g_vOffset;

  static const float outlierStepV = autoOutlierStep(V_NOMINAL_RMS * sqrtf(2.0f) * 5.0f, FREQ_REF_HZ, SAMPLE_RATE_HZ);
  static const float outlierStepI = autoOutlierStep(I_NOMINAL_RMS * sqrtf(2.0f) * 10.0f, FREQ_REF_HZ, SAMPLE_RATE_HZ);
  bool outlier = false;
  if (g_havePrev) {
    if (fabsf(vInst - g_vPrev) > outlierStepV) {
      vInst = g_vPrev;
      outlier = true;
    }
    if (fabsf(iInst - g_iPrev) > outlierStepI) {
      iInst = g_iPrev;
      outlier = true;
    }
  }
  g_vPrev = vInst;
  g_iPrev = iInst;
  g_havePrev = true;
  if (outlier) g_cycleFlags |= FLAG_OUTLIER;

  float zcHystAdc = max(0.002f, ZC_HYST_REAL / max(1e-9f, fabsf(V_SCALE_ENG_PER_VOLT)));
  int8_t newState = g_zcState;
  if (vAcAdc < -zcHystAdc) newState = -1;
  else if (vAcAdc > zcHystAdc) newState = 1;

  uint8_t cycleUpdate = 0;
  if (g_zcState == -1 && newState == 1) {
    closeCycle(sampleUs);
    resetCycle(sampleUs);
    cycleUpdate = 1;
  }
  g_zcState = newState;

  appendCycleSample(vInst, iInst);
  logSample(sampleUs, adcV, adcI, vInst, iInst, cycleUpdate);
  g_seq++;
}

static void printStatus() {
  Serial.printf(
    "STATUS running=%u seq=%lu cycles=%lu log=%u V1=%.6f I1=%.6f f=%.3f valid=%u "
    "oc=%s dist=%s voltage=%s relay=%u qf=%u\n",
    g_running ? 1 : 0,
    (unsigned long)g_seq,
    (unsigned long)g_cycleId,
    g_logCount,
    g_v1Mag,
    g_i1Mag,
    g_fEst,
    g_fourierValid,
    ocTripCode(),
    distTripCode(),
    voltageTripCode(),
    (g_ocTrip || g_distTrip || g_uvTrip || g_ovTrip) ? 1 : 0,
    g_lastQualityFlags
  );
}

static void printHelp() {
  Serial.println("Commands:");
  Serial.println("  h/help       show commands");
  Serial.println("  start        resume sampling/protection");
  Serial.println("  stop         pause sampling/protection");
  Serial.println("  status       print current state");
  Serial.println("  dump         dump compact RAM log as essential CSV");
  Serial.println("  clear        clear RAM log");
  Serial.println("  header       print CSV header");
  Serial.println("  stream on    stream one CSV row per completed cycle");
  Serial.println("  stream off   stop cycle CSV streaming");
  Serial.println("  resettrip    clear latched trips and relay");
}

static void handleSerial() {
  if (!Serial.available()) return;
  String line = Serial.readStringUntil('\n');
  line.trim();
  line.toLowerCase();
  if (line.length() == 0) return;

  if (line == "h" || line == "help") {
    printHelp();
  } else if (line == "start") {
    g_running = true;
    Serial.println("OK start");
  } else if (line == "stop") {
    g_running = false;
    Serial.println("OK stop");
  } else if (line == "status") {
    printStatus();
  } else if (line == "dump") {
    dumpLogCsv();
  } else if (line == "clear") {
    clearLog();
    Serial.println("OK clear");
  } else if (line == "header") {
    printCsvHeader();
  } else if (line == "stream on") {
    g_streamCycleCsv = true;
    g_csvHeaderPrinted = false;
    Serial.println("OK stream=on");
  } else if (line == "stream off") {
    g_streamCycleCsv = false;
    Serial.println("OK stream=off");
  } else if (line == "resettrip") {
    resetTrips();
    Serial.println("OK resettrip");
  } else {
    Serial.printf("ERR unknown_cmd=%s\n", line.c_str());
  }
}

void setup() {
  Serial.begin(SERIAL_BAUD);
  Serial.setTimeout(50);
  delay(300);

  analogReadResolution(12);
  analogSetPinAttenuation(ADC_PIN_V, ADC_11db);
  analogSetPinAttenuation(ADC_PIN_I, ADC_11db);

  pinMode(RELAY_PIN, OUTPUT);
  setRelay(false);

  g_distZ1Circle = mhoCircle(g_distZ1Ohm, DIST_LINE_ANGLE_DEG);
  g_distZ2Circle = mhoCircle(g_distZ2Ohm, DIST_LINE_ANGLE_DEG);

  Serial.printf(
    "READY_EMBEDDED_RX baud=%lu fs=%lu log_capacity=%u relay_pin=%d v_scale=%.6f i_scale=%.6f\n",
    (unsigned long)SERIAL_BAUD,
    (unsigned long)SAMPLE_RATE_HZ,
    LOG_CAPACITY,
    RELAY_PIN,
    V_SCALE_ENG_PER_VOLT,
    I_SCALE_ENG_PER_VOLT
  );
  printHelp();
}

void loop() {
  handleSerial();
  processSample();
}
