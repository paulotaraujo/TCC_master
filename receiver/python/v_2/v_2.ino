// =============================================================================
// v_2.ino - ESP32 embedded receiver/protection prototype
//
// Based on receiver/python/v_1/v_1.ino + read_from_generator_rms_robust.py.
// The ESP32 now owns the critical path:
//   ADC -> offset/scale -> cycle detection -> Fourier phasors -> protections -> relay outputs.
//
// The firmware does not write oscillography files. Protection results are exposed
// directly on ESP32 GPIOs to drive a 4-channel relay module.
// =============================================================================

#include <Arduino.h>
#include <math.h>

static const int ADC_PIN_V = 35;
static const int ADC_PIN_I = 34;

static const int LED_SYSTEM_READY_PIN = 13;   // D13: firmware ready to receive samples.
static const int LED_ANY_TRIP_PIN = 12;       // D12: blinks while any trip is latched.

static const int RELAY_DIST_BLOCK_PIN = 14;   // IN1: 21/67 blocked by direction.
static const int RELAY_DIST_ENABLE_PIN = 27;  // IN2: 21/67 permissive / enable zone.
static const int RELAY_DIST_Z1_PIN = 26;      // IN3: distance zone 1 trip.
static const int RELAY_DIST_Z2_PIN = 25;      // IN4: distance zone 2 trip.

static const uint32_t SERIAL_BAUD = 921600;
static uint32_t SAMPLE_RATE_HZ = 1000;
static const int N_AVG = 8;

static const float ADC_MAX = 4095.0f;
static const float ADC_VREF = 3.3f;

// Keep these values synchronized with receiver_config.json generated by v_6.
static float V_SCALE_ENG_PER_VOLT = 1168993.55f;
static float I_SCALE_ENG_PER_VOLT = 11851.6129f;
static float V_NOMINAL_RMS = 256247.016f;
static float I_NOMINAL_RMS = 1298.9552f;
static float FREQ_REF_HZ = 60.0f;
static float F_MIN_HZ = 55.0f;
static float F_MAX_HZ = 65.0f;

static float OFFSET_TAU_S = 1.0f;
static float ZC_HYST_REAL = 0.03f;
static bool NORMALIZE_TO_COMTRADE = true;
static const int PREFAULT_CYCLES = 10;
static float NORM_MIN_PU = 0.5f;

// Protection configuration. Enable only the functions needed for the test.
static bool OC_ENABLED = false;
static float OC_51_PCT = 10.0f;
static float OC_50_PCT = 20.0f;
static float OC_51_DELAY_S = 0.5f;

static bool DIST_ENABLED = true;
static float DIST_LINE_Z_OHM = 52.12496f;
static float DIST_Z1_PCT = 80.0f;
static float DIST_Z2_PCT = 120.0f;
static float DIST_Z2_DELAY_S = 0.05f;
static float DIST_LINE_ANGLE_DEG = 86.636f;
static float DIST_MIN_CURRENT = 0.05f * I_NOMINAL_RMS;

static bool DIR67_ENABLED = true;
static bool DIR67_FORWARD = true;
static float DIR67_ANGLE_DEG = 86.636f;
static float DIR67_WINDOW_DEG = 90.0f;
static float DIR67_POWER_MIN_W = 10000.0f;

static bool UV_ENABLED = false;
static float UV_PICKUP_PCT = 90.0f;
static float UV_DELAY_S = 0.2f;

static bool OV_ENABLED = false;
static float OV_PICKUP_PCT = 110.0f;
static float OV_DELAY_S = 0.2f;

static bool PROTECTION_EVENTS = false;
static float PROTECTION_EVENT_INTERVAL_S = 0.05f;
static const bool RELAY_ACTIVE_LOW = false;
static const uint32_t SYSTEM_READY_LED_BLINK_INTERVAL_MS = 500;
static const uint32_t TRIP_LED_BLINK_INTERVAL_MS = 500;

static const uint8_t FLAG_ADC_SAT = 1 << 3;
static const uint8_t FLAG_OUTLIER = 1 << 4;
static const uint8_t FLAG_INCOMPLETE_CYCLE = 1 << 5;
static const uint8_t FLAG_FREQ_OOR = 1 << 6;

static const uint16_t MAX_CYCLE_SAMPLES = 160;

struct Phasor {
  float mag = 0.0f;
  float angleDeg = 0.0f;
};

struct MhoCircle {
  float centerR = 0.0f;
  float centerX = 0.0f;
  float radius = 0.0f;
};

static uint32_t g_seq = 0;
static bool g_running = false;
static bool g_systemReady = false;

static float g_vOffset = 1.65f;
static float g_iOffset = 1.65f;
static float g_vPrev = 0.0f;
static float g_iPrev = 0.0f;
static bool g_havePrev = false;

static int8_t g_zcState = 0;
static uint32_t g_cycleStartUs = 0;
static bool g_haveCycleStart = false;
static uint16_t g_cycleN = 0;
static float g_cycleSumV2 = 0.0f;
static float g_cycleSumI2 = 0.0f;
static float g_cycleV[MAX_CYCLE_SAMPLES];
static float g_cycleI[MAX_CYCLE_SAMPLES];
static uint8_t g_cycleFlags = 0;

static uint32_t g_cycleId = 0;
static float g_v1Mag = 0.0f;
static float g_i1Mag = 0.0f;
static float g_v1Angle = 0.0f;
static float g_i1Angle = 0.0f;
static float g_viAngle = 0.0f;
static float g_fEst = 0.0f;
static uint8_t g_fourierValid = 0;
static uint8_t g_lastQualityFlags = 0;

static uint8_t g_normReady = 0;
static float g_normGainV = 1.0f;
static float g_normGainI = 1.0f;
static float g_prefaultV[PREFAULT_CYCLES];
static float g_prefaultI[PREFAULT_CYCLES];
static uint8_t g_prefaultCount = 0;

static float g_oc51Pickup = I_NOMINAL_RMS * (1.0f + OC_51_PCT / 100.0f);
static float g_oc50Pickup = I_NOMINAL_RMS * (1.0f + OC_50_PCT / 100.0f);
static float g_oc51Dropout = 0.95f * g_oc51Pickup;
static float g_oc51Timer = 0.0f;
static float g_oc51TimingReport = 0.0f;
static uint8_t g_oc51Active = 0;
static uint8_t g_oc50Trip = 0;
static uint8_t g_oc51Trip = 0;
static uint8_t g_ocTrip = 0;

static float g_distZ1Ohm = DIST_LINE_Z_OHM * (DIST_Z1_PCT / 100.0f);
static float g_distZ2Ohm = DIST_LINE_Z_OHM * (DIST_Z2_PCT / 100.0f);
static float g_distZ2DropoutOhm = 1.05f * g_distZ2Ohm;
static MhoCircle g_distZ1Circle;
static MhoCircle g_distZ2Circle;
static float g_distZMag = 0.0f;
static float g_distZAngle = 0.0f;
static float g_distR = 0.0f;
static float g_distX = 0.0f;
static float g_distFaultPct = 0.0f;
static float g_distZ2Timer = 0.0f;
static float g_distZ2TimingReport = 0.0f;
static uint8_t g_distZ2Active = 0;
static uint8_t g_distZ1Operate = 0;
static uint8_t g_distZ2Operate = 0;
static uint8_t g_distZ1Trip = 0;
static uint8_t g_distZ2Trip = 0;
static uint8_t g_distTrip = 0;
static uint8_t g_distEnableTrip = 0;
static uint8_t g_distBlockTrip = 0;
static uint8_t g_dir67Permit = 0;
static uint8_t g_dir67BlockActive = 0;
static float g_dir67Power = 0.0f;
static float g_dir67PrefaultPower = 0.0f;

static float g_uvPickup = V_NOMINAL_RMS * (UV_PICKUP_PCT / 100.0f);
static float g_uvDropout = 1.03f * g_uvPickup;
static float g_ovPickup = V_NOMINAL_RMS * (OV_PICKUP_PCT / 100.0f);
static float g_ovDropout = 0.97f * g_ovPickup;
static float g_uvTimer = 0.0f;
static float g_ovTimer = 0.0f;
static float g_uvTimingReport = 0.0f;
static float g_ovTimingReport = 0.0f;
static uint8_t g_uvActive = 0;
static uint8_t g_ovActive = 0;
static uint8_t g_uvTrip = 0;
static uint8_t g_ovTrip = 0;
static uint8_t g_breakerTripReported = 0;

static MhoCircle mhoCircle(float reachOhm, float lineAngleDeg);

static uint32_t samplePeriodUs() {
  return 1000000UL / max((uint32_t)1, SAMPLE_RATE_HZ);
}

static void recomputeSettings() {
  g_oc51Pickup = I_NOMINAL_RMS * (1.0f + OC_51_PCT / 100.0f);
  g_oc50Pickup = I_NOMINAL_RMS * (1.0f + OC_50_PCT / 100.0f);
  g_oc51Dropout = 0.95f * g_oc51Pickup;

  g_distZ1Ohm = DIST_LINE_Z_OHM * (DIST_Z1_PCT / 100.0f);
  g_distZ2Ohm = DIST_LINE_Z_OHM * (DIST_Z2_PCT / 100.0f);
  g_distZ2DropoutOhm = 1.05f * g_distZ2Ohm;
  DIST_MIN_CURRENT = 0.05f * I_NOMINAL_RMS;
  g_distZ1Circle = mhoCircle(g_distZ1Ohm, DIST_LINE_ANGLE_DEG);
  g_distZ2Circle = mhoCircle(g_distZ2Ohm, DIST_LINE_ANGLE_DEG);

  g_uvPickup = V_NOMINAL_RMS * (UV_PICKUP_PCT / 100.0f);
  g_uvDropout = 1.03f * g_uvPickup;
  g_ovPickup = V_NOMINAL_RMS * (OV_PICKUP_PCT / 100.0f);
  g_ovDropout = 0.97f * g_ovPickup;
}

static float wrapAngleDeg(float angleDeg) {
  float wrapped = fmodf(angleDeg + 180.0f, 360.0f);
  if (wrapped < 0.0f) wrapped += 360.0f;
  wrapped -= 180.0f;
  if (wrapped == -180.0f) return 180.0f;
  return wrapped;
}

static float adcToVolts(uint16_t adc) {
  return ((float)adc / ADC_MAX) * ADC_VREF;
}

static float autoOutlierStep(float ampPeak, float freqHz, float sampleRateHz) {
  float fs = max(1.0f, sampleRateHz);
  float f = max(1.0f, freqHz);
  float a = max(1.0f, fabsf(ampPeak));
  float maxStep = a * (2.0f * PI * f) / fs;
  return max(0.8f, 6.0f * maxStep);
}

static uint16_t readAdcAvg(int pin, int n) {
  uint32_t acc = 0;
  for (int i = 0; i < n; ++i) acc += analogRead(pin);
  uint32_t avg = acc / (uint32_t)n;
  if (avg > 4095) avg = 4095;
  return (uint16_t)avg;
}

static Phasor fundamentalPhasorRms(const float *samples, uint16_t n) {
  Phasor out;
  if (n < 2) return out;

  float re = 0.0f;
  float im = 0.0f;
  for (uint16_t k = 0; k < n; ++k) {
    float theta = (2.0f * PI * (float)k) / (float)n;
    re += samples[k] * cosf(theta);
    im -= samples[k] * sinf(theta);
  }

  float peakMag = (2.0f / (float)n) * sqrtf(re * re + im * im);
  out.mag = peakMag / sqrtf(2.0f);
  out.angleDeg = wrapAngleDeg(atan2f(im, re) * 180.0f / PI);
  return out;
}

static MhoCircle mhoCircle(float reachOhm, float lineAngleDeg) {
  float angleRad = lineAngleDeg * PI / 180.0f;
  MhoCircle circle;
  circle.radius = 0.5f * reachOhm;
  circle.centerR = circle.radius * cosf(angleRad);
  circle.centerX = circle.radius * sinf(angleRad);
  return circle;
}

static bool mhoOperates(float rOhm, float xOhm, float reachOhm, float lineAngleDeg) {
  MhoCircle c = mhoCircle(reachOhm, lineAngleDeg);
  float dr = rOhm - c.centerR;
  float dx = xOhm - c.centerX;
  return (dr * dr + dx * dx) <= (c.radius * c.radius);
}

static void writeRelay(int pin, bool active) {
  if (RELAY_ACTIVE_LOW) {
    digitalWrite(pin, active ? LOW : HIGH);
  } else {
    digitalWrite(pin, active ? HIGH : LOW);
  }
}

static void updateRelayOutputs() {
  bool z1 = g_distZ1Trip != 0;
  bool z2 = (g_distZ2Active != 0) || (g_distZ2Trip != 0);
  bool enable = (g_distEnableTrip != 0) || z1 || z2;

  writeRelay(RELAY_DIST_BLOCK_PIN, g_distBlockTrip != 0);
  writeRelay(RELAY_DIST_ENABLE_PIN, enable);
  writeRelay(RELAY_DIST_Z1_PIN, z1);
  writeRelay(RELAY_DIST_Z2_PIN, z2);
}

static void updateSystemReadyLed() {
  static bool ledState = false;
  static bool initialized = false;
  static int8_t writtenState = -1;
  static uint32_t lastToggleMs = 0;

  if (g_systemReady) {
    ledState = true;
    initialized = true;
    if (writtenState != HIGH) {
      digitalWrite(LED_SYSTEM_READY_PIN, HIGH);
      writtenState = HIGH;
    }
    return;
  }

  uint32_t nowMs = millis();
  if (!initialized) {
    ledState = true;
    initialized = true;
    lastToggleMs = nowMs;
    if (writtenState != HIGH) {
      digitalWrite(LED_SYSTEM_READY_PIN, HIGH);
      writtenState = HIGH;
    }
    return;
  }

  if (nowMs - lastToggleMs >= SYSTEM_READY_LED_BLINK_INTERVAL_MS) {
    ledState = !ledState;
    lastToggleMs = nowMs;
    int8_t nextState = ledState ? HIGH : LOW;
    if (writtenState != nextState) {
      digitalWrite(LED_SYSTEM_READY_PIN, nextState);
      writtenState = nextState;
    }
  }
}

static bool anyTripLatched() {
  return (g_ocTrip != 0) || (g_oc50Trip != 0) || (g_oc51Trip != 0) ||
         (g_distTrip != 0) || (g_distZ1Trip != 0) || (g_distZ2Trip != 0) ||
         (g_uvTrip != 0) || (g_ovTrip != 0);
}

static void updateTripLed() {
  static bool ledState = false;
  static bool wasTripped = false;
  static int8_t writtenState = -1;
  static uint32_t lastToggleMs = 0;

  if (!anyTripLatched()) {
    if (wasTripped || ledState || writtenState != LOW) {
      ledState = false;
      wasTripped = false;
      lastToggleMs = millis();
      digitalWrite(LED_ANY_TRIP_PIN, LOW);
      writtenState = LOW;
    }
    return;
  }

  uint32_t nowMs = millis();
  if (!wasTripped) {
    ledState = true;
    wasTripped = true;
    lastToggleMs = nowMs;
    if (writtenState != HIGH) {
      digitalWrite(LED_ANY_TRIP_PIN, HIGH);
      writtenState = HIGH;
    }
    return;
  }

  if (nowMs - lastToggleMs >= TRIP_LED_BLINK_INTERVAL_MS) {
    ledState = !ledState;
    lastToggleMs = nowMs;
    int8_t nextState = ledState ? HIGH : LOW;
    if (writtenState != nextState) {
      digitalWrite(LED_ANY_TRIP_PIN, nextState);
      writtenState = nextState;
    }
  }
}

static void testRelayOutputs() {
  bool wasRunning = g_running;
  g_running = false;
  resetTrips();

  Serial.println("TEST_RELAY block");
  writeRelay(RELAY_DIST_BLOCK_PIN, true);
  delay(1200);
  writeRelay(RELAY_DIST_BLOCK_PIN, false);

  Serial.println("TEST_RELAY enable");
  writeRelay(RELAY_DIST_ENABLE_PIN, true);
  delay(1200);
  writeRelay(RELAY_DIST_ENABLE_PIN, false);

  Serial.println("TEST_RELAY z1");
  writeRelay(RELAY_DIST_Z1_PIN, true);
  delay(1200);
  writeRelay(RELAY_DIST_Z1_PIN, false);

  Serial.println("TEST_RELAY z2");
  writeRelay(RELAY_DIST_Z2_PIN, true);
  delay(1200);
  writeRelay(RELAY_DIST_Z2_PIN, false);

  updateRelayOutputs();
  g_running = wasRunning;
  Serial.println("OK testrelays");
}

static const char *voltageTripCode() {
  if (g_uvTrip) return "27";
  if (g_ovTrip) return "59";
  return "NONE";
}

static const char *distTripCode() {
  if (g_distZ1Trip) return "21Z1";
  if (g_distZ2Trip) return "21Z2";
  return "NONE";
}

static const char *ocTripCode() {
  if (g_oc50Trip) return "50";
  if (g_oc51Trip) return "51";
  return "NONE";
}

static float medianSmall(float *values, uint8_t count) {
  for (uint8_t i = 1; i < count; ++i) {
    float key = values[i];
    int j = i - 1;
    while (j >= 0 && values[j] > key) {
      values[j + 1] = values[j];
      j--;
    }
    values[j + 1] = key;
  }
  return values[count / 2];
}

static void resetTrips() {
  g_oc51Timer = 0.0f;
  g_oc51TimingReport = 0.0f;
  g_oc51Active = 0;
  g_oc50Trip = 0;
  g_oc51Trip = 0;
  g_ocTrip = 0;
  g_distZ2Timer = 0.0f;
  g_distZ2TimingReport = 0.0f;
  g_distZ2Active = 0;
  g_distZ1Operate = 0;
  g_distZ2Operate = 0;
  g_distZ1Trip = 0;
  g_distZ2Trip = 0;
  g_distTrip = 0;
  g_distEnableTrip = 0;
  g_distBlockTrip = 0;
  g_dir67Permit = 0;
  g_dir67BlockActive = 0;
  g_uvTimer = 0.0f;
  g_ovTimer = 0.0f;
  g_uvTimingReport = 0.0f;
  g_ovTimingReport = 0.0f;
  g_uvActive = 0;
  g_ovActive = 0;
  g_uvTrip = 0;
  g_ovTrip = 0;
  g_breakerTripReported = 0;
  updateRelayOutputs();
  updateTripLed();
}

static void evaluateProtections(float cycleDtS) {
  bool evalReady = g_fourierValid == 1;
  float tS = (float)micros() / 1000000.0f;

  if (g_breakerTripReported != 0) {
    updateRelayOutputs();
    return;
  }

  g_distZ1Operate = 0;
  g_distZ2Operate = 0;

  if (OC_ENABLED && evalReady) {
    uint8_t prevOc51Active = g_oc51Active;
    uint8_t prevOc50Trip = g_oc50Trip;
    uint8_t prevOc51Trip = g_oc51Trip;
    if (g_i1Mag >= g_oc50Pickup) {
      g_oc50Trip = 1;
      g_ocTrip = 1;
      if (PROTECTION_EVENTS && prevOc50Trip == 0) {
        Serial.printf(
          "EVENT [OC50 TRIP] t=%.6fs I1=%.6fA pickup=%.6fA delay=instantaneous\n",
          tS, g_i1Mag, g_oc50Pickup
        );
      }
    }
    if (g_i1Mag >= g_oc51Pickup) {
      g_oc51Active = 1;
      g_oc51Timer += cycleDtS;
      if (PROTECTION_EVENTS && prevOc51Active == 0) {
        Serial.printf(
          "EVENT [OC51 PICKUP] t=%.6fs I1=%.6fA pickup=%.6fA timer=%.6fs delay=%.6fs\n",
          tS, g_i1Mag, g_oc51Pickup, g_oc51Timer, OC_51_DELAY_S
        );
        g_oc51TimingReport = g_oc51Timer;
      } else if (
        PROTECTION_EVENTS &&
        PROTECTION_EVENT_INTERVAL_S > 0.0f &&
        g_oc51Timer - g_oc51TimingReport >= PROTECTION_EVENT_INTERVAL_S &&
        g_oc51Trip == 0
      ) {
        Serial.printf(
          "EVENT [OC51 TIMING] t=%.6fs I1=%.6fA timer=%.6f/%.6fs\n",
          tS, g_i1Mag, g_oc51Timer, OC_51_DELAY_S
        );
        g_oc51TimingReport = g_oc51Timer;
      }
      if (g_oc51Timer >= OC_51_DELAY_S) {
        g_oc51Trip = 1;
        g_ocTrip = 1;
        if (PROTECTION_EVENTS && prevOc51Trip == 0) {
          Serial.printf(
            "EVENT [OC51 TRIP] t=%.6fs I1=%.6fA pickup=%.6fA elapsed=%.6fs\n",
            tS, g_i1Mag, g_oc51Pickup, g_oc51Timer
          );
        }
      }
    } else if (g_i1Mag < g_oc51Dropout) {
      if (!g_oc51Trip) {
        if (PROTECTION_EVENTS && g_oc51Active == 1) {
          Serial.printf(
            "EVENT [OC51 RESET] t=%.6fs I1=%.6fA dropout=%.6fA timer_reset=%.6fs\n",
            tS, g_i1Mag, g_oc51Dropout, g_oc51Timer
          );
        }
        g_oc51Active = 0;
        g_oc51Timer = 0.0f;
        g_oc51TimingReport = 0.0f;
      }
    } else {
      g_oc51Active = 0;
    }
  }

  if (DIST_ENABLED && evalReady && g_i1Mag > max(1e-12f, DIST_MIN_CURRENT)) {
    uint8_t prevDistZ2Active = g_distZ2Active;
    uint8_t prevDistZ1Trip = g_distZ1Trip;
    uint8_t prevDistZ2Trip = g_distZ2Trip;
    uint8_t prevDir67BlockActive = g_dir67BlockActive;

    g_distZMag = g_v1Mag / max(1e-12f, g_i1Mag);
    g_distZAngle = wrapAngleDeg(g_v1Angle - g_i1Angle);
    float angleRad = g_distZAngle * PI / 180.0f;
    g_distR = g_distZMag * cosf(angleRad);
    g_distX = g_distZMag * sinf(angleRad);
    g_distFaultPct = (g_distZMag / DIST_LINE_Z_OHM) * 100.0f;

    bool z1Mho = mhoOperates(g_distR, g_distX, g_distZ1Ohm, DIST_LINE_ANGLE_DEG) && g_distZMag <= g_distZ1Ohm;
    bool z2Mho = mhoOperates(g_distR, g_distX, g_distZ2Ohm, DIST_LINE_ANGLE_DEG) && !z1Mho && g_distZMag <= g_distZ2Ohm;
    bool z2Dropout = mhoOperates(g_distR, g_distX, g_distZ2DropoutOhm, DIST_LINE_ANGLE_DEG);
    bool anyMho = z1Mho || z2Mho;
    g_distZ1Operate = z1Mho ? 1 : 0;
    g_distZ2Operate = z2Mho ? 1 : 0;

    bool dirOk = true;
    if (DIR67_ENABLED) {
      g_dir67Power = g_v1Mag * g_i1Mag * cosf((g_v1Angle - g_i1Angle) * PI / 180.0f);
      if (!anyMho && fabsf(g_dir67Power) > DIR67_POWER_MIN_W) {
        g_dir67PrefaultPower = g_dir67Power;
      }
      bool forward = g_dir67PrefaultPower > DIR67_POWER_MIN_W;
      bool reverse = g_dir67PrefaultPower < -DIR67_POWER_MIN_W;
      dirOk = DIR67_FORWARD ? forward : reverse;
    } else {
      g_dir67Power = 0.0f;
      dirOk = true;
    }
    g_dir67Permit = (anyMho && dirOk) ? 1 : 0;

    if (anyMho && !g_dir67Permit) {
      g_dir67BlockActive = 1;
      g_distBlockTrip = 1;
      g_distZ2Active = 0;
      g_distZ2Timer = 0.0f;
      g_distZ2TimingReport = 0.0f;
      if (PROTECTION_EVENTS && prevDir67BlockActive == 0) {
        Serial.printf(
          "EVENT [D21 BLOCKED BY 67] t=%.6fs |Z|=%.6fohm R=%.6fohm X=%.6fohm "
          "fault=%.6fohm %.3f%%line Z1_mho=%u Z2_mho=%u dir_set=%s "
          "P67=%.6fW P67_prefault=%.6fW Pmin=%.6fW forward=%u reverse=%u\n",
          tS,
          g_distZMag,
          g_distR,
          g_distX,
          g_distZMag,
          g_distFaultPct,
          g_distZ1Operate,
          g_distZ2Operate,
          DIR67_FORWARD ? "forward" : "reverse",
          g_dir67Power,
          g_dir67PrefaultPower,
          DIR67_POWER_MIN_W,
          g_dir67PrefaultPower > DIR67_POWER_MIN_W ? 1 : 0,
          g_dir67PrefaultPower < -DIR67_POWER_MIN_W ? 1 : 0
        );
      }
    } else if (z1Mho) {
      g_dir67BlockActive = 0;
      g_distZ2Active = 0;
      g_distEnableTrip = 1;
      g_distZ1Trip = 1;
      g_distTrip = 1;
      if (PROTECTION_EVENTS && prevDistZ1Trip == 0) {
        Serial.printf(
          "EVENT [D21Z1 TRIP] t=%.6fs |Z|=%.6fohm R=%.6fohm X=%.6fohm "
          "fault=%.6fohm %.3f%%line I1=%.6fA V1=%.6f zone=Z1 type=MHO "
          "reach=%.6fohm line_angle=%.3fdeg dir67_permit=%u delay=instantaneous\n",
          tS,
          g_distZMag,
          g_distR,
          g_distX,
          g_distZMag,
          g_distFaultPct,
          g_i1Mag,
          g_v1Mag,
          g_distZ1Ohm,
          DIST_LINE_ANGLE_DEG,
          g_dir67Permit
        );
      }
    } else if (z2Mho) {
      g_dir67BlockActive = 0;
      g_distZ2Active = 1;
      g_distEnableTrip = 1;
      g_distZ2Timer += cycleDtS;
      if (PROTECTION_EVENTS && prevDistZ2Active == 0 && g_distZ2Trip == 0) {
        Serial.printf(
          "EVENT [D21Z2 PICKUP] t=%.6fs |Z|=%.6fohm R=%.6fohm X=%.6fohm "
          "fault=%.6fohm %.3f%%line I1=%.6fA V1=%.6f zone=Z2 type=MHO "
          "reach=%.6fohm line_angle=%.3fdeg dir67_permit=%u timer=%.6fs delay=%.6fs\n",
          tS,
          g_distZMag,
          g_distR,
          g_distX,
          g_distZMag,
          g_distFaultPct,
          g_i1Mag,
          g_v1Mag,
          g_distZ2Ohm,
          DIST_LINE_ANGLE_DEG,
          g_dir67Permit,
          g_distZ2Timer,
          DIST_Z2_DELAY_S
        );
        g_distZ2TimingReport = g_distZ2Timer;
      } else if (
        PROTECTION_EVENTS &&
        PROTECTION_EVENT_INTERVAL_S > 0.0f &&
        g_distZ2Timer - g_distZ2TimingReport >= PROTECTION_EVENT_INTERVAL_S &&
        g_distZ2Trip == 0
      ) {
        Serial.printf(
          "EVENT [D21Z2 TIMING] t=%.6fs |Z|=%.6fohm R=%.6fohm X=%.6fohm "
          "fault=%.6fohm %.3f%%line zone=Z2 type=MHO reach=%.6fohm timer=%.6f/%.6fs\n",
          tS,
          g_distZMag,
          g_distR,
          g_distX,
          g_distZMag,
          g_distFaultPct,
          g_distZ2Ohm,
          g_distZ2Timer,
          DIST_Z2_DELAY_S
        );
        g_distZ2TimingReport = g_distZ2Timer;
      }
      if (g_distZ2Timer >= DIST_Z2_DELAY_S) {
        g_distZ2Trip = 1;
        g_distTrip = 1;
        if (PROTECTION_EVENTS && prevDistZ2Trip == 0) {
          Serial.printf(
            "EVENT [D21Z2 TRIP] t=%.6fs |Z|=%.6fohm R=%.6fohm X=%.6fohm "
            "fault=%.6fohm %.3f%%line I1=%.6fA V1=%.6f zone=Z2 type=MHO "
            "reach=%.6fohm elapsed=%.6fs\n",
            tS,
            g_distZMag,
            g_distR,
            g_distX,
            g_distZMag,
            g_distFaultPct,
            g_i1Mag,
            g_v1Mag,
            g_distZ2Ohm,
            g_distZ2Timer
          );
        }
      }
    } else if (!z2Dropout && !g_distZ2Trip) {
      if (PROTECTION_EVENTS && g_distZ2Active == 1) {
        Serial.printf(
          "EVENT [D21Z2 RESET] t=%.6fs |Z|=%.6fohm fault=%.6fohm %.3f%%line "
          "type=MHO dropout_reach=%.6fohm timer_reset=%.6fs\n",
          tS,
          g_distZMag,
          g_distZMag,
          g_distFaultPct,
          g_distZ2DropoutOhm,
          g_distZ2Timer
        );
      }
      g_distZ2Active = 0;
      g_distZ2Timer = 0.0f;
      g_distZ2TimingReport = 0.0f;
      g_dir67BlockActive = 0;
    } else {
      g_distZ2Active = 0;
      g_dir67BlockActive = 0;
    }
  }

  if ((UV_ENABLED || OV_ENABLED) && evalReady) {
    if (UV_ENABLED) {
      if (g_v1Mag <= g_uvPickup) {
        uint8_t prevUvActive = g_uvActive;
        uint8_t prevUvTrip = g_uvTrip;
        g_uvActive = 1;
        g_uvTimer += cycleDtS;
        if (PROTECTION_EVENTS && prevUvActive == 0) {
          Serial.printf(
            "EVENT [UV27 PICKUP] t=%.6fs V1=%.6f pickup=%.6f timer=%.6fs delay=%.6fs\n",
            tS, g_v1Mag, g_uvPickup, g_uvTimer, UV_DELAY_S
          );
          g_uvTimingReport = g_uvTimer;
        } else if (
          PROTECTION_EVENTS &&
          PROTECTION_EVENT_INTERVAL_S > 0.0f &&
          g_uvTimer - g_uvTimingReport >= PROTECTION_EVENT_INTERVAL_S &&
          g_uvTrip == 0
        ) {
          Serial.printf(
            "EVENT [UV27 TIMING] t=%.6fs V1=%.6f timer=%.6f/%.6fs\n",
            tS, g_v1Mag, g_uvTimer, UV_DELAY_S
          );
          g_uvTimingReport = g_uvTimer;
        }
        if (g_uvTimer >= UV_DELAY_S) {
          g_uvTrip = 1;
          if (PROTECTION_EVENTS && prevUvTrip == 0) {
            Serial.printf(
              "EVENT [UV27 TRIP] t=%.6fs V1=%.6f pickup=%.6f elapsed=%.6fs\n",
              tS, g_v1Mag, g_uvPickup, g_uvTimer
            );
          }
        }
      } else if (g_v1Mag > g_uvDropout && !g_uvTrip) {
        if (PROTECTION_EVENTS && g_uvActive == 1) {
          Serial.printf(
            "EVENT [UV27 RESET] t=%.6fs V1=%.6f dropout=%.6f timer_reset=%.6fs\n",
            tS, g_v1Mag, g_uvDropout, g_uvTimer
          );
        }
        g_uvActive = 0;
        g_uvTimer = 0.0f;
        g_uvTimingReport = 0.0f;
      }
    }
    if (OV_ENABLED) {
      if (g_v1Mag >= g_ovPickup) {
        uint8_t prevOvActive = g_ovActive;
        uint8_t prevOvTrip = g_ovTrip;
        g_ovActive = 1;
        g_ovTimer += cycleDtS;
        if (PROTECTION_EVENTS && prevOvActive == 0) {
          Serial.printf(
            "EVENT [OV59 PICKUP] t=%.6fs V1=%.6f pickup=%.6f timer=%.6fs delay=%.6fs\n",
            tS, g_v1Mag, g_ovPickup, g_ovTimer, OV_DELAY_S
          );
          g_ovTimingReport = g_ovTimer;
        } else if (
          PROTECTION_EVENTS &&
          PROTECTION_EVENT_INTERVAL_S > 0.0f &&
          g_ovTimer - g_ovTimingReport >= PROTECTION_EVENT_INTERVAL_S &&
          g_ovTrip == 0
        ) {
          Serial.printf(
            "EVENT [OV59 TIMING] t=%.6fs V1=%.6f timer=%.6f/%.6fs\n",
            tS, g_v1Mag, g_ovTimer, OV_DELAY_S
          );
          g_ovTimingReport = g_ovTimer;
        }
        if (g_ovTimer >= OV_DELAY_S) {
          g_ovTrip = 1;
          if (PROTECTION_EVENTS && prevOvTrip == 0) {
            Serial.printf(
              "EVENT [OV59 TRIP] t=%.6fs V1=%.6f pickup=%.6f elapsed=%.6fs\n",
              tS, g_v1Mag, g_ovPickup, g_ovTimer
            );
          }
        }
      } else if (g_v1Mag < g_ovDropout && !g_ovTrip) {
        if (PROTECTION_EVENTS && g_ovActive == 1) {
          Serial.printf(
            "EVENT [OV59 RESET] t=%.6fs V1=%.6f dropout=%.6f timer_reset=%.6fs\n",
            tS, g_v1Mag, g_ovDropout, g_ovTimer
          );
        }
        g_ovActive = 0;
        g_ovTimer = 0.0f;
        g_ovTimingReport = 0.0f;
      }
    }
  }

  if (PROTECTION_EVENTS && g_breakerTripReported == 0 && (g_ocTrip || g_distTrip || g_uvTrip || g_ovTrip)) {
    char sources[40] = "";
    if (g_oc50Trip) strcat(sources, "50;");
    if (g_oc51Trip) strcat(sources, "51;");
    if (g_distZ1Trip) strcat(sources, "21Z1;");
    if (g_distZ2Trip) strcat(sources, "21Z2;");
    if (g_uvTrip) strcat(sources, "27;");
    if (g_ovTrip) strcat(sources, "59;");
    size_t n = strlen(sources);
    if (n > 0 && sources[n - 1] == ';') sources[n - 1] = '\0';
    Serial.printf(
      "EVENT [BREAKER TRIP] t=%.6fs source=%s I1=%.6fA V1=%.6f |Z|=%.6fohm R=%.6fohm X=%.6fohm fault=%.6fohm %.3f%%line\n",
      tS,
      sources,
      g_i1Mag,
      g_v1Mag,
      g_distZMag,
      g_distR,
      g_distX,
      g_distZMag,
      g_distFaultPct
    );
    g_breakerTripReported = 1;
  }

  updateRelayOutputs();
}

static void closeCycle(uint32_t nowUs) {
  if (!g_haveCycleStart) return;

  uint32_t periodUs = nowUs - g_cycleStartUs;
  uint8_t localFlags = g_cycleFlags;
  uint8_t localValid = 1;

  if (g_cycleN < 8) {
    localFlags |= FLAG_INCOMPLETE_CYCLE;
    localValid = 0;
    g_v1Mag = 0.0f;
    g_i1Mag = 0.0f;
    g_v1Angle = 0.0f;
    g_i1Angle = 0.0f;
    g_fEst = 0.0f;
  } else {
    Phasor v1 = fundamentalPhasorRms(g_cycleV, g_cycleN);
    Phasor i1 = fundamentalPhasorRms(g_cycleI, g_cycleN);
    g_v1Mag = v1.mag;
    g_i1Mag = i1.mag;
    g_v1Angle = v1.angleDeg;
    g_i1Angle = i1.angleDeg;
    g_fEst = 1000000.0f / max(1.0f, (float)periodUs);
    if (!(F_MIN_HZ <= g_fEst && g_fEst <= F_MAX_HZ)) {
      localFlags |= FLAG_FREQ_OOR;
      localValid = 0;
    }

    if (NORMALIZE_TO_COMTRADE && localValid == 1) {
      float minVRaw = max(1e-9f, NORM_MIN_PU * V_NOMINAL_RMS);
      float minIRaw = max(1e-9f, NORM_MIN_PU * I_NOMINAL_RMS);
      bool goodForNorm = g_v1Mag >= minVRaw && g_i1Mag >= minIRaw;
      if (!g_normReady && goodForNorm && g_prefaultCount < PREFAULT_CYCLES) {
        g_prefaultV[g_prefaultCount] = g_v1Mag;
        g_prefaultI[g_prefaultCount] = g_i1Mag;
        g_prefaultCount++;
        if (g_prefaultCount >= PREFAULT_CYCLES) {
          float tmpV[PREFAULT_CYCLES];
          float tmpI[PREFAULT_CYCLES];
          for (int i = 0; i < PREFAULT_CYCLES; ++i) {
            tmpV[i] = g_prefaultV[i];
            tmpI[i] = g_prefaultI[i];
          }
          g_normGainV = V_NOMINAL_RMS / max(1e-9f, medianSmall(tmpV, PREFAULT_CYCLES));
          g_normGainI = I_NOMINAL_RMS / max(1e-9f, medianSmall(tmpI, PREFAULT_CYCLES));
          g_normReady = 1;
        }
      }
      if (g_normReady) {
        g_v1Mag *= g_normGainV;
        g_i1Mag *= g_normGainI;
      }
    }
  }

  g_viAngle = wrapAngleDeg(g_i1Angle - g_v1Angle);
  g_fourierValid = localValid;
  g_lastQualityFlags = localFlags;
  evaluateProtections((float)periodUs / 1000000.0f);
  g_cycleId++;
}

static void resetCycle(uint32_t nowUs) {
  g_cycleStartUs = nowUs;
  g_haveCycleStart = true;
  g_cycleN = 0;
  g_cycleSumV2 = 0.0f;
  g_cycleSumI2 = 0.0f;
  g_cycleFlags = 0;
}

static void appendCycleSample(float vInst, float iInst) {
  if (!g_haveCycleStart) return;
  if (g_cycleN < MAX_CYCLE_SAMPLES) {
    g_cycleV[g_cycleN] = vInst;
    g_cycleI[g_cycleN] = iInst;
    g_cycleN++;
  } else {
    g_cycleFlags |= FLAG_INCOMPLETE_CYCLE;
  }
  g_cycleSumV2 += vInst * vInst;
  g_cycleSumI2 += iInst * iInst;
}

static void processSample() {
  static uint32_t nextUs = 0;
  uint32_t now = micros();
  uint32_t periodUs = samplePeriodUs();
  if (nextUs == 0) nextUs = now + periodUs;
  if ((int32_t)(now - nextUs) < 0) return;
  nextUs += periodUs;
  if ((int32_t)(now - nextUs) > (int32_t)(4 * periodUs)) {
    nextUs = now + periodUs;
  }
  if (!g_running) return;

  uint16_t adcV = readAdcAvg(ADC_PIN_V, N_AVG);
  uint16_t adcI = readAdcAvg(ADC_PIN_I, N_AVG);
  uint32_t sampleUs = micros();

  float dtS = (float)periodUs / 1000000.0f;
  float vAdc = adcToVolts(adcV);
  float iAdc = adcToVolts(adcI);

  if (adcV <= 1 || adcV >= 4094 || adcI <= 1 || adcI >= 4094) {
    g_cycleFlags |= FLAG_ADC_SAT;
  }

  float alpha = dtS / max(1e-6f, OFFSET_TAU_S);
  if (alpha > 1.0f) alpha = 1.0f;
  g_vOffset += alpha * (vAdc - g_vOffset);
  g_iOffset += alpha * (iAdc - g_iOffset);

  float vInst = (vAdc - g_vOffset) * V_SCALE_ENG_PER_VOLT;
  float iInst = (iAdc - g_iOffset) * I_SCALE_ENG_PER_VOLT;
  float vAcAdc = vAdc - g_vOffset;

  float outlierStepV = autoOutlierStep(V_NOMINAL_RMS * sqrtf(2.0f) * 5.0f, FREQ_REF_HZ, SAMPLE_RATE_HZ);
  float outlierStepI = autoOutlierStep(I_NOMINAL_RMS * sqrtf(2.0f) * 10.0f, FREQ_REF_HZ, SAMPLE_RATE_HZ);
  bool outlier = false;
  if (g_havePrev) {
    if (fabsf(vInst - g_vPrev) > outlierStepV) {
      vInst = g_vPrev;
      outlier = true;
    }
    if (fabsf(iInst - g_iPrev) > outlierStepI) {
      iInst = g_iPrev;
      outlier = true;
    }
  }
  g_vPrev = vInst;
  g_iPrev = iInst;
  g_havePrev = true;
  if (outlier) g_cycleFlags |= FLAG_OUTLIER;

  float zcHystAdc = max(0.002f, ZC_HYST_REAL / max(1e-9f, fabsf(V_SCALE_ENG_PER_VOLT)));
  int8_t newState = g_zcState;
  if (vAcAdc < -zcHystAdc) newState = -1;
  else if (vAcAdc > zcHystAdc) newState = 1;

  if (g_zcState == -1 && newState == 1) {
    closeCycle(sampleUs);
    resetCycle(sampleUs);
  }
  g_zcState = newState;

  appendCycleSample(vInst, iInst);
  g_seq++;
}

static void printStatus() {
  Serial.printf(
    "STATUS running=%u seq=%lu cycles=%lu V1=%.6f I1=%.6f f=%.3f valid=%u "
    "norm=%u gain_v=%.6f gain_i=%.6f Z=%.6f R=%.6f X=%.6f "
    "z1_op=%u z2_op=%u z2_active=%u z2_timer=%.6f dir_permit=%u dir_block=%u events=%u "
    "oc=%s dist=%s voltage=%s block=%u enable=%u z1=%u z2=%u qf=%u\n",
    g_running ? 1 : 0,
    (unsigned long)g_seq,
    (unsigned long)g_cycleId,
    g_v1Mag,
    g_i1Mag,
    g_fEst,
    g_fourierValid,
    g_normReady,
    g_normGainV,
    g_normGainI,
    g_distZMag,
    g_distR,
    g_distX,
    g_distZ1Operate,
    g_distZ2Operate,
    g_distZ2Active,
    g_distZ2Timer,
    g_dir67Permit,
    g_dir67BlockActive,
    PROTECTION_EVENTS ? 1 : 0,
    ocTripCode(),
    distTripCode(),
    voltageTripCode(),
    g_distBlockTrip,
    (g_distEnableTrip || g_distZ1Trip || g_distZ2Trip) ? 1 : 0,
    g_distZ1Trip,
    g_distZ2Trip,
    g_lastQualityFlags
  );
}

static void printHelp() {
  Serial.println("Commands:");
  Serial.println("  h/help       show commands");
  Serial.println("  cfg k v      set runtime config value");
  Serial.println("  start        resume sampling/protection");
  Serial.println("  stop         pause sampling/protection");
  Serial.println("  status       print current state");
  Serial.println("  resettrip    clear latched trips and relay outputs");
  Serial.println("  testrelays   pulse block/enable/z1/z2 relay outputs");
}

static bool parseBoolValue(const String &value) {
  return value == "1" || value == "true" || value == "on" || value == "yes";
}

static void applyRuntimeConfig(const String &key, const String &value) {
  if (key == "sample_rate_hz") SAMPLE_RATE_HZ = (uint32_t)max(1L, value.toInt());
  else if (key == "v_scale") V_SCALE_ENG_PER_VOLT = value.toFloat();
  else if (key == "i_scale") I_SCALE_ENG_PER_VOLT = value.toFloat();
  else if (key == "v_nominal_rms") V_NOMINAL_RMS = value.toFloat();
  else if (key == "i_nominal_rms") I_NOMINAL_RMS = value.toFloat();
  else if (key == "freq_ref_hz") FREQ_REF_HZ = value.toFloat();
  else if (key == "f_min_hz") F_MIN_HZ = value.toFloat();
  else if (key == "f_max_hz") F_MAX_HZ = value.toFloat();
  else if (key == "normalize_to_comtrade") NORMALIZE_TO_COMTRADE = parseBoolValue(value);
  else if (key == "norm_min_pu") NORM_MIN_PU = value.toFloat();
  else if (key == "oc_enabled") OC_ENABLED = parseBoolValue(value);
  else if (key == "oc_51_pct") OC_51_PCT = value.toFloat();
  else if (key == "oc_50_pct") OC_50_PCT = value.toFloat();
  else if (key == "oc_51_delay_s") OC_51_DELAY_S = value.toFloat();
  else if (key == "dist_enabled") DIST_ENABLED = parseBoolValue(value);
  else if (key == "dist_line_z_ohm") DIST_LINE_Z_OHM = value.toFloat();
  else if (key == "dist_z1_pct") DIST_Z1_PCT = value.toFloat();
  else if (key == "dist_z2_pct") DIST_Z2_PCT = value.toFloat();
  else if (key == "dist_z2_delay_s") DIST_Z2_DELAY_S = value.toFloat();
  else if (key == "dist_line_angle_deg") DIST_LINE_ANGLE_DEG = value.toFloat();
  else if (key == "dir67_enabled") DIR67_ENABLED = parseBoolValue(value);
  else if (key == "dir67_forward") DIR67_FORWARD = parseBoolValue(value);
  else if (key == "dir67_angle_deg") DIR67_ANGLE_DEG = value.toFloat();
  else if (key == "dir67_window_deg") DIR67_WINDOW_DEG = value.toFloat();
  else if (key == "dir67_power_min_w") DIR67_POWER_MIN_W = value.toFloat();
  else if (key == "uv_enabled") UV_ENABLED = parseBoolValue(value);
  else if (key == "uv_pickup_pct") UV_PICKUP_PCT = value.toFloat();
  else if (key == "uv_delay_s") UV_DELAY_S = value.toFloat();
  else if (key == "ov_enabled") OV_ENABLED = parseBoolValue(value);
  else if (key == "ov_pickup_pct") OV_PICKUP_PCT = value.toFloat();
  else if (key == "ov_delay_s") OV_DELAY_S = value.toFloat();
  else if (key == "protection_events") PROTECTION_EVENTS = parseBoolValue(value);
  else if (key == "protection_event_interval_s") PROTECTION_EVENT_INTERVAL_S = value.toFloat();
  else {
    Serial.printf("ERR cfg_unknown=%s\n", key.c_str());
    return;
  }

  recomputeSettings();
  Serial.printf("ACK cfg %s=%s\n", key.c_str(), value.c_str());
}

static void handleSerial() {
  if (!Serial.available()) return;
  String line = Serial.readStringUntil('\n');
  line.trim();
  line.toLowerCase();
  if (line.length() == 0) return;

  if (line == "h" || line == "help") {
    printHelp();
  } else if (line.startsWith("cfg ")) {
    int firstSpace = line.indexOf(' ');
    int secondSpace = line.indexOf(' ', firstSpace + 1);
    if (secondSpace < 0) {
      Serial.println("ERR cfg_syntax");
      return;
    }
    String key = line.substring(firstSpace + 1, secondSpace);
    String value = line.substring(secondSpace + 1);
    key.trim();
    value.trim();
    applyRuntimeConfig(key, value);
  } else if (line == "start") {
    g_running = true;
    g_systemReady = true;
    updateSystemReadyLed();
    Serial.println("OK start");
  } else if (line == "stop") {
    g_running = false;
    g_systemReady = false;
    updateSystemReadyLed();
    Serial.println("OK stop");
  } else if (line == "status") {
    printStatus();
  } else if (line == "resettrip") {
    resetTrips();
    Serial.println("OK resettrip");
  } else if (line == "testrelays") {
    testRelayOutputs();
  } else {
    Serial.printf("ERR unknown_cmd=%s\n", line.c_str());
  }
}

void setup() {
  Serial.begin(SERIAL_BAUD);
  Serial.setTimeout(50);
  delay(300);

  g_systemReady = false;

  analogReadResolution(12);
  analogSetPinAttenuation(ADC_PIN_V, ADC_11db);
  analogSetPinAttenuation(ADC_PIN_I, ADC_11db);

  pinMode(RELAY_DIST_BLOCK_PIN, OUTPUT);
  pinMode(RELAY_DIST_ENABLE_PIN, OUTPUT);
  pinMode(RELAY_DIST_Z1_PIN, OUTPUT);
  pinMode(RELAY_DIST_Z2_PIN, OUTPUT);
  pinMode(LED_SYSTEM_READY_PIN, OUTPUT);
  pinMode(LED_ANY_TRIP_PIN, OUTPUT);
  digitalWrite(RELAY_DIST_BLOCK_PIN, LOW);
  digitalWrite(RELAY_DIST_ENABLE_PIN, LOW);
  digitalWrite(RELAY_DIST_Z1_PIN, LOW);
  digitalWrite(RELAY_DIST_Z2_PIN, LOW);
  digitalWrite(LED_SYSTEM_READY_PIN, LOW);
  digitalWrite(LED_ANY_TRIP_PIN, LOW);
  updateRelayOutputs();
  updateSystemReadyLed();

  g_distZ1Circle = mhoCircle(g_distZ1Ohm, DIST_LINE_ANGLE_DEG);
  g_distZ2Circle = mhoCircle(g_distZ2Ohm, DIST_LINE_ANGLE_DEG);
  Serial.printf(
    "READY_EMBEDDED_RX baud=%lu fs=%lu relays_block_enable_z1_z2=%d,%d,%d,%d led_ready=%d led_any_trip=%d active_low=%u v_scale=%.6f i_scale=%.6f\n",
    (unsigned long)SERIAL_BAUD,
    (unsigned long)SAMPLE_RATE_HZ,
    RELAY_DIST_BLOCK_PIN,
    RELAY_DIST_ENABLE_PIN,
    RELAY_DIST_Z1_PIN,
    RELAY_DIST_Z2_PIN,
    LED_SYSTEM_READY_PIN,
    LED_ANY_TRIP_PIN,
    RELAY_ACTIVE_LOW ? 1 : 0,
    V_SCALE_ENG_PER_VOLT,
    I_SCALE_ENG_PER_VOLT
  );
  printHelp();
}

void loop() {
  handleSerial();
  processSample();
  if (!g_running) {
    updateSystemReadyLed();
  }
  if (g_ocTrip || g_distTrip || g_uvTrip || g_ovTrip) {
    updateTripLed();
  }
}
